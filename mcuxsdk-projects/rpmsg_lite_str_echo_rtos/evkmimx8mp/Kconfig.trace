## mcuxsdk-projects/rpmsg_lite_str_echo_rtos/evkmimx8mp/Kconfig.trace
```kconfig
config CUSTOM_APP_RPMSG_LITE_STR_ECHO_RTOS_REMOTE
    bool
    default y
    select MCUX_PRJSEG_config.arm.warn_as_error
    select MCUX_PRJSEG_config.arm.shared
    select MCUX_PRJSEG_config.kinetis.shared
    select MCUX_PRJSEG_config.device_core.define
    select MCUX_PRJSEG_config.arm.core.cm7f
    select MCUX_PRJSEG_config.arm.core.fpu.fpv5_dp
    select MCUX_COMPONENT_CMSIS_Include_core_cm
    select MCUX_PRJSEG_module.device.suite
    select MCUX_COMPONENT_middleware.multicore.rpmsg-lite.imx8mp_m7
```

## mcuxsdk-projects/sai_interrupt_transfer/evkmimx8mp/Kconfig.trace
```kconfig
config CUSTOM_APP_SAI_INTERRUPT_TRANSFER
    bool
    default y
    select MCUX_PRJSEG_config.arm.warn_as_error
    select MCUX_PRJSEG_config.arm.shared
    select MCUX_PRJSEG_config.kinetis.shared
    select MCUX_PRJSEG_config.device_core.define
    select MCUX_PRJSEG_config.arm.core.cm7f
    select MCUX_PRJSEG_config.arm.core.fpu.fpv5_dp
    select MCUX_COMPONENT_CMSIS_Include_core_cm
    select MCUX_PRJSEG_module.device.suite
    select MCUX_COMPONENT_component.codec_i2c
    select MCUX_COMPONENT_driver.codec
    select MCUX_COMPONENT_component.codec_adapters
    select MCUX_COMPONENT_component.wm8960_adapter
```
